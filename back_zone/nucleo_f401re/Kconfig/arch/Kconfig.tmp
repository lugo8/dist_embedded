## back_zone/nucleo_f401re/Kconfig/arch/Kconfig.tmp
```kconfig
# Load Zephyr Arch Kconfig descriptions.
osource "C:/Users/biote/Documents/dist_embedded/dist_embedded/external/zephyr/arch/rx/Kconfig"
osource "C:/Users/biote/Documents/dist_embedded/dist_embedded/external/zephyr/arch/x86/Kconfig"
osource "C:/Users/biote/Documents/dist_embedded/dist_embedded/external/zephyr/arch/xtensa/Kconfig"
osource "C:/Users/biote/Documents/dist_embedded/dist_embedded/external/zephyr/arch/sparc/Kconfig"
osource "C:/Users/biote/Documents/dist_embedded/dist_embedded/external/zephyr/arch/riscv/Kconfig"
osource "C:/Users/biote/Documents/dist_embedded/dist_embedded/external/zephyr/arch/posix/Kconfig"
osource "C:/Users/biote/Documents/dist_embedded/dist_embedded/external/zephyr/arch/openrisc/Kconfig"
osource "C:/Users/biote/Documents/dist_embedded/dist_embedded/external/zephyr/arch/mips/Kconfig"
osource "C:/Users/biote/Documents/dist_embedded/dist_embedded/external/zephyr/arch/arm64/Kconfig"
osource "C:/Users/biote/Documents/dist_embedded/dist_embedded/external/zephyr/arch/arm/Kconfig"
osource "C:/Users/biote/Documents/dist_embedded/dist_embedded/external/zephyr/arch/arc/Kconfig"
```

## back_zone/nucleo_f401re/Kconfig/boards/Kconfig.esp32c3_042_oled
```kconfig
# Load board Kconfig descriptions.
osource "C:/Users/biote/Documents/dist_embedded/dist_embedded/external/zephyr/boards/01space/esp32c3_042_oled/Kconfig.esp32c3_042_oled"
```

## blinky/build/nucleo_f401re/stm32f401xe/Kconfig/boards/Kconfig
```kconfig
# Load Zephyr board Kconfig descriptions.
osource "C:/Users/biote/OneDrive/Documents/zephyr/external/zephyr/boards/st/nucleo_f401re/Kconfig"
```

## blinky/build/nucleo_f401re/stm32f401xe/Kconfig/boards/Kconfig.defconfig.tmp
```kconfig
# Load Zephyr board defconfig descriptions.
osource "C:/Users/biote/OneDrive/Documents/zephyr/external/zephyr/boards/st/nucleo_f401re/Kconfig.defconfig"
```

## blinky/build/nucleo_f401re/stm32f401xe/Kconfig/boards/Kconfig.nucleo_f401re
```kconfig
# Load board Kconfig descriptions.
osource "C:/Users/biote/OneDrive/Documents/zephyr/external/zephyr/boards/st/nucleo_f401re/Kconfig.nucleo_f401re"
```

## blinky/build/nucleo_f401re/stm32f401xe/Kconfig/boards/Kconfig.sysbuild
```kconfig
# Load Sysbuild board Kconfig descriptions.
osource "C:/Users/biote/OneDrive/Documents/zephyr/external/zephyr/boards/st/nucleo_f401re/Kconfig.sysbuild"
```

## blinky/build/nucleo_wb05kz/stm32wb05/Kconfig/arch/Kconfig
```kconfig
# Load Zephyr Arch Kconfig descriptions.
osource "C:/Users/biote/OneDrive/Documents/zephyr/external/zephyr/arch/rx/Kconfig"
osource "C:/Users/biote/OneDrive/Documents/zephyr/external/zephyr/arch/x86/Kconfig"
osource "C:/Users/biote/OneDrive/Documents/zephyr/external/zephyr/arch/xtensa/Kconfig"
osource "C:/Users/biote/OneDrive/Documents/zephyr/external/zephyr/arch/sparc/Kconfig"
osource "C:/Users/biote/OneDrive/Documents/zephyr/external/zephyr/arch/riscv/Kconfig"
osource "C:/Users/biote/OneDrive/Documents/zephyr/external/zephyr/arch/posix/Kconfig"
osource "C:/Users/biote/OneDrive/Documents/zephyr/external/zephyr/arch/openrisc/Kconfig"
osource "C:/Users/biote/OneDrive/Documents/zephyr/external/zephyr/arch/mips/Kconfig"
osource "C:/Users/biote/OneDrive/Documents/zephyr/external/zephyr/arch/arm64/Kconfig"
osource "C:/Users/biote/OneDrive/Documents/zephyr/external/zephyr/arch/arm/Kconfig"
osource "C:/Users/biote/OneDrive/Documents/zephyr/external/zephyr/arch/arc/Kconfig"
```

## blinky/build/nucleo_wb05kz/stm32wb05/Kconfig/boards/Kconfig.defconfig
```kconfig
# Load Zephyr board defconfig descriptions.
osource "C:/Users/biote/OneDrive/Documents/zephyr/external/zephyr/boards/st/nucleo_wb05kz/Kconfig.defconfig"
```

## blinky/build/nucleo_wb05kz/stm32wb05/Kconfig/boards/Kconfig.nucleo_wb05kz.tmp
```kconfig
# Load board Kconfig descriptions.
osource "C:/Users/biote/OneDrive/Documents/zephyr/external/zephyr/boards/st/nucleo_wb05kz/Kconfig.nucleo_wb05kz"
```

## blinky/build/nucleo_wb05kz/stm32wb05/Kconfig/boards/Kconfig.sysbuild.tmp
```kconfig
# Load Sysbuild board Kconfig descriptions.
osource "C:/Users/biote/OneDrive/Documents/zephyr/external/zephyr/boards/st/nucleo_wb05kz/Kconfig.sysbuild"
```

## build-rear/Kconfig/arch/Kconfig
```kconfig
# Load Zephyr Arch Kconfig descriptions.
osource "/Users/leesiena/Desktop/18-649/external/zephyr/arch/rx/Kconfig"
osource "/Users/leesiena/Desktop/18-649/external/zephyr/arch/x86/Kconfig"
osource "/Users/leesiena/Desktop/18-649/external/zephyr/arch/xtensa/Kconfig"
osource "/Users/leesiena/Desktop/18-649/external/zephyr/arch/sparc/Kconfig"
osource "/Users/leesiena/Desktop/18-649/external/zephyr/arch/riscv/Kconfig"
osource "/Users/leesiena/Desktop/18-649/external/zephyr/arch/posix/Kconfig"
osource "/Users/leesiena/Desktop/18-649/external/zephyr/arch/openrisc/Kconfig"
osource "/Users/leesiena/Desktop/18-649/external/zephyr/arch/mips/Kconfig"
osource "/Users/leesiena/Desktop/18-649/external/zephyr/arch/arm64/Kconfig"
osource "/Users/leesiena/Desktop/18-649/external/zephyr/arch/arm/Kconfig"
osource "/Users/leesiena/Desktop/18-649/external/zephyr/arch/arc/Kconfig"
```

## firmware/build/Kconfig/arch/Kconfig
```kconfig
# Load Zephyr Arch Kconfig descriptions.
osource "C:/Users/xhriz/zephyrproject/zephyr/arch/tricore/Kconfig"
osource "C:/Users/xhriz/zephyrproject/zephyr/arch/hexagon/Kconfig"
osource "C:/Users/xhriz/zephyrproject/zephyr/arch/rx/Kconfig"
osource "C:/Users/xhriz/zephyrproject/zephyr/arch/x86/Kconfig"
osource "C:/Users/xhriz/zephyrproject/zephyr/arch/xtensa/Kconfig"
osource "C:/Users/xhriz/zephyrproject/zephyr/arch/sparc/Kconfig"
osource "C:/Users/xhriz/zephyrproject/zephyr/arch/riscv/Kconfig"
osource "C:/Users/xhriz/zephyrproject/zephyr/arch/posix/Kconfig"
osource "C:/Users/xhriz/zephyrproject/zephyr/arch/openrisc/Kconfig"
osource "C:/Users/xhriz/zephyrproject/zephyr/arch/mips/Kconfig"
osource "C:/Users/xhriz/zephyrproject/zephyr/arch/arm64/Kconfig"
osource "C:/Users/xhriz/zephyrproject/zephyr/arch/arm/Kconfig"
osource "C:/Users/xhriz/zephyrproject/zephyr/arch/arc/Kconfig"
```

## firmware/build/Kconfig/boards/Kconfig.defconfig
```kconfig
# Load Zephyr board defconfig descriptions.
osource "C:/Users/xhriz/zephyrproject/zephyr/boards/st/nucleo_f401re/Kconfig.defconfig"
```

## firmware/build/Kconfig/boards/Kconfig.nucleo_f401re
```kconfig
# Load board Kconfig descriptions.
osource "C:/Users/xhriz/zephyrproject/zephyr/boards/st/nucleo_f401re/Kconfig.nucleo_f401re"
```

## firmware/build/Kconfig/boards/Kconfig.sysbuild
```kconfig
# Load Sysbuild board Kconfig descriptions.
osource "C:/Users/xhriz/zephyrproject/zephyr/boards/st/nucleo_f401re/Kconfig.sysbuild"
```

## front-rear/Kconfig/boards/Kconfig.defconfig
```kconfig
# Load Zephyr board defconfig descriptions.
osource "/Users/leesiena/Desktop/18-649/external/zephyr/boards/st/nucleo_f401re/Kconfig.defconfig"
```

## front-rear/Kconfig/boards/Kconfig.nucleo_f401re
```kconfig
# Load board Kconfig descriptions.
osource "/Users/leesiena/Desktop/18-649/external/zephyr/boards/st/nucleo_f401re/Kconfig.nucleo_f401re"
```

## zone_1/build/nucleo_f401re/stm32f401xe/Kconfig/boards/Kconfig.sysbuild.tmp
```kconfig
# Load Sysbuild board Kconfig descriptions.
osource "/Users/leesiena/Desktop/18-649/external/zephyr/boards/st/nucleo_f401re/Kconfig.sysbuild"
```
